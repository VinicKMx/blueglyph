## CMakeLists.txt
```
cmake_minimum_required(VERSION 3.20.0)

find_package(Zephyr REQUIRED HINTS $ENV{ZEPHYR_BASE})
project(blueglyph_firmware C)

target_sources(app PRIVATE
  src/capture.c
  src/main.c
  src/protocol.c
  src/radio.c
  src/timestamp.c
  src/usb.c
)

target_include_directories(app PRIVATE src)
```

## prj.conf
```kconfig
CONFIG_ASSERT=y
CONFIG_LOG=y
CONFIG_MAIN_STACK_SIZE=2048
CONFIG_SYSTEM_WORKQUEUE_STACK_SIZE=2048
```

## src/main.c
```c
#include <zephyr/kernel.h>
#include <zephyr/logging/log.h>

#include "capture.h"
#include "radio.h"
#include "usb.h"

LOG_MODULE_REGISTER(blueglyph_main, LOG_LEVEL_INF);

int main(void)
{
	int err;

	LOG_INF("blueglyph firmware boot");

	err = blueglyph_capture_init();
	if (err != 0) {
		LOG_ERR("capture init failed: %d", err);
		return err;
	}

	err = blueglyph_radio_init();
	if (err != 0) {
		LOG_ERR("radio init failed: %d", err);
		return err;
	}

	err = blueglyph_usb_transport_init();
	if (err != 0) {
		LOG_ERR("USB transport init failed: %d", err);
		return err;
	}

	while (true) {
		struct blueglyph_capture_stats stats;

		blueglyph_capture_get_stats(&stats);
		LOG_DBG("capture idle, packets=%u dropped=%u malformed=%u",
			stats.packets_captured,
			stats.packets_dropped,
			stats.malformed_frames);
		k_sleep(K_SECONDS(1));
	}

	return 0;
}
```

## src/capture.c
```c
#include "capture.h"

#include <string.h>

#include "timestamp.h"

static struct blueglyph_capture_stats capture_stats;

int blueglyph_capture_init(void)
{
	memset(&capture_stats, 0, sizeof(capture_stats));
	return 0;
}

void blueglyph_capture_record_packet(void)
{
	capture_stats.packets_captured++;
}

void blueglyph_capture_record_drop(void)
{
	capture_stats.packets_dropped++;
}

void blueglyph_capture_record_malformed_frame(void)
{
	capture_stats.malformed_frames++;
}

void blueglyph_capture_get_stats(struct blueglyph_capture_stats *stats)
{
	if (stats == NULL) {
		return;
	}

	*stats = capture_stats;
	stats->uptime_us = blueglyph_timestamp_now_us();
}
```

## src/capture.h
```c
#ifndef BLUEGLYPH_CAPTURE_H
#define BLUEGLYPH_CAPTURE_H

#include <stdint.h>

struct blueglyph_capture_stats {
	uint32_t packets_captured;
	uint32_t packets_dropped;
	uint32_t malformed_frames;
	uint64_t uptime_us;
};

int blueglyph_capture_init(void);
void blueglyph_capture_record_packet(void);
void blueglyph_capture_record_drop(void);
void blueglyph_capture_record_malformed_frame(void);
void blueglyph_capture_get_stats(struct blueglyph_capture_stats *stats);

#endif /* BLUEGLYPH_CAPTURE_H */
```

## src/protocol.c
```c
#include "protocol.h"

#include <errno.h>

#include <zephyr/sys/byteorder.h>

int blueglyph_protocol_encode_header(uint8_t *dst, size_t dst_len,
				  const struct blueglyph_message_header *header)
{
	if (dst == NULL || header == NULL) {
		return -EINVAL;
	}
	if (dst_len < BLUEGLYPH_PROTOCOL_HEADER_SIZE) {
		return -EMSGSIZE;
	}

	sys_put_le16(BLUEGLYPH_PROTOCOL_MAGIC, &dst[0]);
	dst[2] = BLUEGLYPH_PROTOCOL_VERSION;
	dst[3] = header->message_type;
	sys_put_le16(header->payload_length, &dst[4]);
	sys_put_le32(header->sequence, &dst[6]);
	sys_put_le64(header->timestamp_us, &dst[10]);

	return 0;
}

int blueglyph_protocol_decode_header(struct blueglyph_message_header *header,
				  const uint8_t *src, size_t src_len)
{
	uint16_t magic;
	uint8_t version;

	if (header == NULL || src == NULL) {
		return -EINVAL;
	}
	if (src_len < BLUEGLYPH_PROTOCOL_HEADER_SIZE) {
		return -EMSGSIZE;
	}

	magic = sys_get_le16(&src[0]);
	if (magic != BLUEGLYPH_PROTOCOL_MAGIC) {
		return -EINVAL;
	}

	version = src[2];
	if (version != BLUEGLYPH_PROTOCOL_VERSION) {
		return -ENOTSUP;
	}

	header->message_type = src[3];
	header->payload_length = sys_get_le16(&src[4]);
	header->sequence = sys_get_le32(&src[6]);
	header->timestamp_us = sys_get_le64(&src[10]);

	return 0;
}
```

## src/protocol.h
```c
#ifndef BLUEGLYPH_PROTOCOL_H
#define BLUEGLYPH_PROTOCOL_H

#include <stddef.h>
#include <stdint.h>

#define BLUEGLYPH_PROTOCOL_MAGIC 0xB1E0u
#define BLUEGLYPH_PROTOCOL_VERSION 1u
#define BLUEGLYPH_PROTOCOL_HEADER_SIZE 18u

enum blueglyph_message_type {
	BLUEGLYPH_MSG_RADIO_PACKET = 0x01,
	BLUEGLYPH_MSG_DEVICE_STATUS = 0x02,
	BLUEGLYPH_MSG_CAPTURE_STATUS = 0x03,
	BLUEGLYPH_MSG_ERROR = 0x04,
	BLUEGLYPH_MSG_COMMAND_RESPONSE = 0x05,
	BLUEGLYPH_MSG_FIRMWARE_INFO = 0x06,
	BLUEGLYPH_MSG_TIME_SYNC = 0x07,
	BLUEGLYPH_MSG_STATISTICS = 0x08,
	BLUEGLYPH_MSG_LOG = 0x09,
};

struct blueglyph_message_header {
	uint8_t message_type;
	uint16_t payload_length;
	uint32_t sequence;
	uint64_t timestamp_us;
};

int blueglyph_protocol_encode_header(uint8_t *dst, size_t dst_len,
				  const struct blueglyph_message_header *header);
int blueglyph_protocol_decode_header(struct blueglyph_message_header *header,
				  const uint8_t *src, size_t src_len);

#endif /* BLUEGLYPH_PROTOCOL_H */
```

## src/radio.c
```c
#include "radio.h"

#include <errno.h>
#include <stdbool.h>

#include <zephyr/logging/log.h>

LOG_MODULE_REGISTER(blueglyph_radio, LOG_LEVEL_INF);

static bool radio_initialized;
static bool radio_capturing;
static uint8_t selected_channel = 37;

int blueglyph_radio_init(void)
{
	radio_initialized = true;
	radio_capturing = false;
	LOG_INF("radio module initialized for future nRF52840 direct RADIO capture");
	return 0;
}

int blueglyph_radio_set_channel(uint8_t channel)
{
	if (!radio_initialized) {
		return -EAGAIN;
	}
	if (channel > 39) {
		return -EINVAL;
	}

	selected_channel = channel;
	LOG_DBG("radio channel set to %u", selected_channel);
	return 0;
}

int blueglyph_radio_start_passive_scan(void)
{
	if (!radio_initialized) {
		return -EAGAIN;
	}

	radio_capturing = true;
	LOG_INF("passive scan requested; hardware capture implementation is pending");
	return 0;
}

int blueglyph_radio_stop(void)
{
	radio_capturing = false;
	LOG_INF("radio capture stopped");
	return 0;
}
```

## src/radio.h
```c
#ifndef BLUEGLYPH_RADIO_H
#define BLUEGLYPH_RADIO_H

#include <stdint.h>

int blueglyph_radio_init(void);
int blueglyph_radio_set_channel(uint8_t channel);
int blueglyph_radio_start_passive_scan(void);
int blueglyph_radio_stop(void);

#endif /* BLUEGLYPH_RADIO_H */
```

## src/timestamp.c
```c
#include "timestamp.h"

#include <zephyr/kernel.h>

uint64_t blueglyph_timestamp_now_us(void)
{
	return k_ticks_to_us_floor64(k_uptime_ticks());
}
```

## src/timestamp.h
```c
#ifndef BLUEGLYPH_TIMESTAMP_H
#define BLUEGLYPH_TIMESTAMP_H

#include <stdint.h>

uint64_t blueglyph_timestamp_now_us(void);

#endif /* BLUEGLYPH_TIMESTAMP_H */
```

## src/usb.c
```c
#include "usb.h"

#include <errno.h>

#include <zephyr/logging/log.h>
#include <zephyr/sys/util.h>

LOG_MODULE_REGISTER(blueglyph_usb, LOG_LEVEL_INF);

int blueglyph_usb_transport_init(void)
{
	LOG_INF("USB transport module initialized; endpoint binding is pending");
	return 0;
}

int blueglyph_usb_transport_send(const uint8_t *data, size_t len)
{
	ARG_UNUSED(data);
	ARG_UNUSED(len);

	return -ENOTSUP;
}
```

## src/usb.h
```c
#ifndef BLUEGLYPH_USB_H
#define BLUEGLYPH_USB_H

#include <stddef.h>
#include <stdint.h>

int blueglyph_usb_transport_init(void);
int blueglyph_usb_transport_send(const uint8_t *data, size_t len);

#endif /* BLUEGLYPH_USB_H */
```
